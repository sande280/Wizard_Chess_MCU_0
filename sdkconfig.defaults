## sdkconfig.defaults
```kconfig
# Use the built-in USB Serial/JTAG controller for the console
CONFIG_ESP_CONSOLE_USB_SERIAL_JTAG=y

# (Optional) Disable the secondary console on UART0 to avoid confusion
#CONFIG_ESP_CONSOLE_SECONDARY_USB_SERIAL_JTAG=n
```
